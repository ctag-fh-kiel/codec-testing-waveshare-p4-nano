## main/Kconfig.projbuild
```kconfig
menu "Example Configuration"

    choice CODEC_SELECTION
        prompt "Select Audio Codec"
        default CODEC_AK4619
        help
            Choose which audio codec to use for this project.

        config CODEC_TLV320AIC3254
            bool "TLV320AIC3254 (Standard)"
            help
                Use the TLV320AIC3254 codec (codec.c).

        config CODEC_AK4619
            bool "AK4619 (TDM Mode)"
            help
                Use the AK4619 codec in TDM mode (ak4619_tdm.c).
    endchoice

endmenu
```
